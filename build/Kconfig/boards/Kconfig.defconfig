## build/Kconfig/boards/Kconfig.defconfig
```kconfig
# Load Zephyr board defconfig descriptions.
osource "/home/thanga-inc-5829/zephyrproject/zephyr/boards/st/nucleo_f446re/Kconfig.defconfig"
```

## build/Kconfig/boards/Kconfig.sysbuild
```kconfig
# Load Sysbuild board Kconfig descriptions.
osource "/home/thanga-inc-5829/zephyrproject/zephyr/boards/st/nucleo_f446re/Kconfig.sysbuild"
```
